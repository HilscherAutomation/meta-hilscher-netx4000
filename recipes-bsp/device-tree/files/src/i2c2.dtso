/dts-v1/;
/plugin/;

/ {
	fragment@0 {
		target = <&i2c2>;
		__overlay__ {
			status = "ok";
			clock-frequency = <100000>;
		};
	};
	__parameters__ {
		i2c2.clock {
		      desc = "I2C clock frequency in Hz";
		      node = "/fragment@0/__overlay__";
		      prop = "clock-frequency";
		      type = "unsigned";
		};
	};
};
