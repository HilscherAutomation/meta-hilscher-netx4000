/dts-v1/;
/plugin/;

/ {
	fragment@0 {
		target = <&can0>;
		__overlay__ {
			status = "okay";
			channels = <0 1 2>;
			pinctrl-names = "default";
			pinctrl-0 = <&can0_0_pins &can0_1_pins &can0_2_pins>;
		};
	};
};
