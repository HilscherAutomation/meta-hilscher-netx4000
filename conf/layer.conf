## conf/layer.conf
```bitbake
# We have a conf and classes directory, add to BBPATH
BBPATH .= ":${LAYERDIR}"

# We have a recipes-* directories, add to BBFILES
BBFILES += "${LAYERDIR}/recipes-*/*/*.bb \
	${LAYERDIR}/recipes-*/*/*.bbappend"

BBFILE_COLLECTIONS += "hilscher-netx4000"
BBFILE_PATTERN_hilscher-netx4000 = "^${LAYERDIR}/"
BBFILE_PRIORITY_hilscher-netx4000 = "6"

LICENSE_PATH += "${LAYERDIR}/licenses"
HILSCHER_LICENSE_PATH = "${LAYERDIR}/licenses"

LAYERSERIES_COMPAT_hilscher-netx4000 = "nanbield"
LAYERDEPENDS_hilscher-netx4000 = " \
	core \
	yocto \
"
```

## conf/local.conf.sample
```bitbake
CONF_VERSION = "1"
PATCHRESOLVE = "noop"

BB_NUMBER_THREADS ?= "${@oe.utils.cpu_count()*2}"
PARALLEL_MAKE ?= "-j ${@oe.utils.cpu_count()*2}"

# DISTRO can be one of the following poky poky-lsb
DISTRO ?= "poky"
# TCLIBC can be one of the following glibc musl
#TCLIBC ?= "musl"

MACHINE ?= "ndeb4000-rev1"

BB_DISKMON_DIRS = "\
    STOPTASKS,${TMPDIR},1G,100K \
    STOPTASKS,${DL_DIR},1G,100K \
    STOPTASKS,${SSTATE_DIR},1G,100K \
    ABORT,${TMPDIR},100M,1K \
    ABORT,${DL_DIR},100M,1K \
    ABORT,${SSTATE_DIR},100M,1K \
"

EXTRA_IMAGE_FEATURES += "empty-root-password allow-empty-password debug-tweaks"

include local.overrides.conf
```

## conf/machine/include/netx4000.inc
```bitbake
DEFAULTTUNE ?= "cortexa9hf-neon"
require conf/machine/include/arm/armv7a/tune-cortexa9.inc

SOC_FAMILY="netx4000"
require conf/machine/include/soc-family.inc

#############################################################################
# Bootloader
#############################################################################
EXTRA_IMAGEDEPENDS += "virtual/bootloader"

PREFERRED_PROVIDER_virtual/bootloader ??= "u-boot"
UBOOT_MACHINE ??= "netx4000_defconfig"
UBOOT_ENTRYPOINT ?= "0x40008000"

PREFERRED_PROVIDER_virtual/kernel ??= "linux-yocto"

PREFERRED_PROVIDER_virtual/dtb ??= "device-tree"
MACHINE_ESSENTIAL_EXTRA_RDEPENDS:append = "${PREFERRED_PROVIDER_virtual/dtb}"

#############################################################################
# Kernel
#############################################################################
KERNEL_CLASSES = "kernel-fitimage"
KERNEL_IMAGETYPES = "fitImage"

MACHINE_ESSENTIAL_EXTRA_RRECOMMENDS += " \
	kernel-modules \
	libcifx cifxsample \
	kernel-module-netx4000-xc-stdmac kernel-module-mdio-xc-netx4000 hethmac \
"

MACHINE_EXTRA_RRECOMMENDS += " \
	dto-utils \
"

#############################################################################
# Contents of boot partition (excluding rootfs)
#############################################################################
IMAGE_BOOT_FILES ??= "netx.rom fitImage-${MACHINE}.bin;fitImage"

WKS_FILE ?= "sdimage-bootpart.wks"
IMAGE_FSTYPES ?= "wic.bz2 wic.bmap"
```

## conf/machine/ndcm4000-rev1.conf
```bitbake
#@TYPE: Machine
#@NAME: ndcm4000-rev1
#@DESCRIPTION: ---
#@PARTNUMBERS: 1832.100R1
#@MAINTAINER: Hilscher Gesellschaft fuer Systemautomation mbH

# --------------------------------------
require conf/machine/include/netx4000.inc
MACHINEOVERRIDES =. "ndcm4000-revx:"

# --------------------------------------
DDR_RAM = "IS43TR16256AL_1GIB"
ENABLE_DDR_ECC = "no"
```

## conf/machine/ndeb4000-rev1.conf
```bitbake
#@TYPE: Machine
#@NAME: ndem4000-rev1
#@DESCRIPTION: ---
#@PARTNUMBERS: 1832.000R1 + 1832.100R1
#@MAINTAINER: Hilscher Gesellschaft fuer Systemautomation mbH

# --------------------------------------
require ndcm4000-rev1.conf
SOC_FAMILY .= ":ndeb4000-revx"

# --------------------------------------
# Add USB function port as serial console.
KERNEL_MODULE_AUTOLOAD:append:pn-linux-stable += "g_serial"
KERNEL_MODULE_AUTOLOAD:append:pn-linux-stable-rt += "g_serial"

SERIAL_CONSOLES = "115200;ttyAMA0"
SERIAL_CONSOLES += "115200;ttyGS0"
```

## conf/machine/netflex4000-rev1.conf
```bitbake
#@TYPE: Machine
#@NAME: netflex400-rev1
#@DESCRIPTION: ---
#@PARTNUMBERS: 1320.101R1
#@MAINTAINER: Hilscher Gesellschaft fuer Systemautomation mbH

# --------------------------------------
require conf/machine/include/netx4000.inc
SOC_FAMILY .= ":netflex4000-revX"

# --------------------------------------
DDR_RAM = "IS43TR16256AL_1GIB"
ENABLE_DDR_ECC = "no"

# --------------------------------------
SERIAL_CONSOLES = "115200;ttyAMA0"

# --------------------------------------
MACHINE_FEATURES_append += "tpm 3g"
```

## conf/machine/nxhx4000-jtag-plus-rev2.conf
```bitbake
#@TYPE: Machine
#@NAME: NXHX4000-JTAG+ board
#@DESCRIPTION: Machine configuration for the Hilscher NXHX4000-JTAG+ board
#@MAINTAINER: Hilscher Gesellschaft fuer Systemautomation mbH

require conf/machine/include/netx4000-rlxd.inc

BAREBOX_DEVICETREE ?= "netx4000/nxhx4000-jtag-plus-rev2.dtb"
#KERNEL_DEVICETREE ?= "netx4000/nxhx4000-jtag-plus-rev2.dtb"

ENABLE_DDR_ECC ?= "yes"
SERIAL_CONSOLE = "115200 ttyAMA0"

IMAGE_CLASSES_append += "image-sdimg"
IMAGE_FSTYPES ?= "sdimg tar.bz2 ubi"

#############################################################################
# UBIFS settings
#############################################################################
# Compression: lzo (faster but larger), zlib (slower but smaller), none
UBI_COMPRESSION ?= "lzo"
UBI_VOLNAME ?= "rootfs"

# -c = max_leb_cnt -> increased to to error "Error: max_leb_cnt too low (2636 needed)"
MKUBIFS_ARGS ?= " -c 4096 -e 126976 -m 2048 -x ${UBI_COMPRESSION} -F"
UBINIZE_ARGS ?= " -m 2048 -p 128KiB -s 2048"
```

## conf/machine/nxhx4000-jtag-plus-rev3.conf
```bitbake
#@TYPE: Machine
#@NAME: NXHX4000-JTAG+ board
#@DESCRIPTION: Machine configuration for the Hilscher NXHX4000-JTAG+ board
#@MAINTAINER: Hilscher Gesellschaft fuer Systemautomation mbH

require conf/machine/include/netx4000.inc

BAREBOX_DEVICETREE ?= "netx4000/nxhx4000-jtag-plus-rev3.dtb"
KERNEL_DEVICETREE ?= "netx4000/nxhx4000-jtag-plus-rev3.dtb"
KERNEL_DEVICETREE_OVERLAYS ?= "netx4000/overlays/adc0.dtbo \
                               netx4000/overlays/adc1.dtbo \
                               netx4000/overlays/i2c1.dtbo:x1800-i2c.dtbo \
                               netx4000/overlays/nxhx4000-rev3-spi0.dtbo:x1800-spi.dtbo \
                               netx4000/overlays/can0.dtbo:x1602-can.dtbo \
                               netx4000/overlays/uart1.dtbo:x1601-uart.dtbo"

ENABLE_DDR_ECC ?= "yes"
SERIAL_CONSOLE = "115200 ttyAMA0"

IMAGE_CLASSES_append += "image-sdimg"
IMAGE_FSTYPES ?= "sdimg tar.bz2"
```

## conf/machine/nxhx4000-jtag-plus-rev4.conf
```bitbake
#@TYPE: Machine
#@NAME: nxhx4000-jtag-plus-rev4
#@DESCRIPTION: ---
#@PARTNUMBERS: 7813.100r4
#@MAINTAINER: Hilscher Gesellschaft fuer Systemautomation mbH

# --------------------------------------
require conf/machine/include/netx4000.inc
SOC_FAMILY .= ":nxhx4000-jtag-plus-revx"

# --------------------------------------
DDR_RAM = "IS43TR16256AL_1GIB"
ENABLE_DDR_ECC = "yes"

# --------------------------------------
# Add USB function port as serial console.
KERNEL_EXTRA_FEATURES_append += " features/usb/usb-gadgets.scc"
KERNEL_MODULE_AUTOLOAD_append_pn-linux-yocto += "g_serial"
KERNEL_MODULE_AUTOLOAD_append_pn-linux-yocto-rt += "g_serial"

SERIAL_CONSOLES = "115200;ttyAMA0"
SERIAL_CONSOLES += "115200;ttyGS0"
```

## conf/machine/nxhx4000-jtag-plus-rev5.conf
```bitbake
#@TYPE: Machine
#@NAME: nxhx4000-jtag-plus-rev5
#@DESCRIPTION: ---
#@PARTNUMBERS: 7813.100r5
#@MAINTAINER: Hilscher Gesellschaft fuer Systemautomation mbH

# --------------------------------------
require conf/machine/include/netx4000.inc
MACHINEOVERRIDES =. "nxhx4000-jtag-plus-revx:"

# --------------------------------------
DDR_RAM = "AS4C512M16D3L_12_2GIB"
ENABLE_DDR_ECC = "yes"

# --------------------------------------
# Add USB function port as serial console
#  media.scc is required for webcam gadget
#  sound.scc is required for midi gadget
KERNEL_EXTRA_FEATURES:append += " features/usb/usb-gadgets.scc features/media/media.scc cfg/sound.scc"
KERNEL_MODULE_AUTOLOAD:append:pn-linux-yocto += "g_serial"
KERNEL_MODULE_AUTOLOAD:append:pn-linux-yocto-rt += "g_serial"

SERIAL_CONSOLES = "115200;ttyAMA0"
SERIAL_CONSOLES += "115200;ttyGS0"
```

## conf/machine/nxhx4000-jtag-plus_rev2.conf
```bitbake
#@TYPE: Machine
#@NAME: NXHX4000-JTAG+ board
#@DESCRIPTION: Machine configuration for the Hilscher NXHX4000-JTAG+ board
#@MAINTAINER: Hilscher Gesellschaft fuer Systemautomation mbH

require conf/machine/include/netx4000.inc

BAREBOX_DEVICETREE ?= "nxhx4000-jtag-plus_rev2.dts"
ENABLE_DDR_ECC ?= "yes"
SERIAL_CONSOLE = "115200 ttyAMA0"

IMAGE_CLASSES += "image-sdimg"
IMAGE_FSTYPES += "sdimg"

#############################################################################
# UBIFS settings
#############################################################################
# Compression: lzo (faster but larger), zlib (slower but smaller), none
UBI_COMPRESSION ?= "lzo"
UBI_VOLNAME ?= "rootfs"

# -c = max_leb_cnt -> increased to to error "Error: max_leb_cnt too low (2636 needed)"
MKUBIFS_ARGS ?= " -c 4096 -e 126976 -m 2048 -x ${UBI_COMPRESSION} -F"
UBINIZE_ARGS ?= " -m 2048 -p 128KiB -s 2048"
```

## recipes-kernel/linux/files/defconfig
```kconfig
CONFIG_KERNEL_LZMA=y
CONFIG_SYSVIPC=y
CONFIG_POSIX_MQUEUE=y
CONFIG_USELIB=y
CONFIG_NO_HZ=y
CONFIG_HIGH_RES_TIMERS=y
CONFIG_BSD_PROCESS_ACCT=y
CONFIG_BSD_PROCESS_ACCT_V3=y
CONFIG_IKCONFIG=y
CONFIG_IKCONFIG_PROC=y
CONFIG_MEMCG=y
CONFIG_MEMCG_SWAP=y
CONFIG_BLK_CGROUP=y
CONFIG_CFS_BANDWIDTH=y
CONFIG_CPUSETS=y
CONFIG_SCHED_AUTOGROUP=y
CONFIG_BLK_DEV_INITRD=y
CONFIG_CC_OPTIMIZE_FOR_SIZE=y
CONFIG_KALLSYMS_ALL=y
CONFIG_EMBEDDED=y
CONFIG_PERF_EVENTS=y
CONFIG_KPROBES=y
CONFIG_MODULES=y
CONFIG_MODULE_UNLOAD=y
CONFIG_PARTITION_ADVANCED=y
CONFIG_ARCH_NETX4000=y
# CONFIG_ARM_ERRATA_643719 is not set
CONFIG_PCI=y
CONFIG_PCI_MSI=y
CONFIG_PCIE_NETX4000=y
CONFIG_SMP=y
CONFIG_HAVE_ARM_ARCH_TIMER=y
CONFIG_NR_CPUS=2
CONFIG_OABI_COMPAT=y
CONFIG_HIGHMEM=y
CONFIG_DEFAULT_MMAP_MIN_ADDR=65536
CONFIG_CLEANCACHE=y
CONFIG_FRONTSWAP=y
CONFIG_SECCOMP=y
CONFIG_USE_OF=y
CONFIG_ZBOOT_ROM_TEXT=0x0
CONFIG_ZBOOT_ROM_BSS=0x0
CONFIG_AUTO_ZRELADDR=y
CONFIG_CPU_FREQ=y
CONFIG_CPU_FREQ_STAT=y
CONFIG_CPU_IDLE=y
CONFIG_CPU_IDLE_GOV_LADDER=y
CONFIG_ARM_CPUIDLE=y
CONFIG_VFP=y
CONFIG_NEON=y
CONFIG_KERNEL_MODE_NEON=y
CONFIG_BINFMT_MISC=m
CONFIG_NET=y
CONFIG_PACKET=y
CONFIG_PACKET_DIAG=y
CONFIG_UNIX=y
CONFIG_CAN=y
CONFIG_CAN_RZA1=y
CONFIG_RFKILL=y
CONFIG_DEVTMPFS=y
CONFIG_DEVTMPFS_MOUNT=y
CONFIG_FW_LOADER=m
CONFIG_MTD=y
CONFIG_MTD_CMDLINE_PARTS=y
CONFIG_MTD_BLOCK=y
CONFIG_MTD_SPI_NOR=y
CONFIG_OF_CONFIGFS=y
CONFIG_BLK_DEV_LOOP=m
CONFIG_BLK_DEV_CRYPTOLOOP=m
CONFIG_BLK_DEV_NBD=m
CONFIG_BLK_DEV_RAM=y
CONFIG_EEPROM_AT24=m
CONFIG_SCSI=y
CONFIG_BLK_DEV_SD=y
CONFIG_NETDEVICES=y
CONFIG_DUMMY=m
CONFIG_NETCONSOLE=y
CONFIG_INET=y
CONFIG_TUN=m
CONFIG_STMMAC_ETH=y
CONFIG_DWMAC_DWC_QOS_ETH=y
CONFIG_NETX4000_XC_STDMAC=m
# CONFIG_DWMAC_GENERIC is not set
CONFIG_MDIO_BITBANG=y
CONFIG_MDIO_GPIO=y
CONFIG_MICROCHIP_PHY=y
CONFIG_VT_HW_CONSOLE_BINDING=y
# CONFIG_LEGACY_PTYS is not set
CONFIG_SERIAL_AMBA_PL011=y
CONFIG_SERIAL_AMBA_PL011_CONSOLE=y
CONFIG_HW_RANDOM=y
CONFIG_I2C=y
CONFIG_SPI=y
CONFIG_SPI_PL022=y
CONFIG_SPI_SPIDEV=y
# CONFIG_PTP_1588_CLOCK is not set
CONFIG_PINCTRL_SINGLE=y
CONFIG_GPIOLIB=y
CONFIG_GPIO_SYSFS=y
CONFIG_WATCHDOG=y
CONFIG_SOFT_WATCHDOG=m
CONFIG_FB=y
CONFIG_HID=m
CONFIG_USB_HID=m
CONFIG_USB=y
CONFIG_USB_EHCI_ROOT_HUB_TT=y
CONFIG_USB_STORAGE=y
CONFIG_USB_GADGET=y
CONFIG_USB_G_SERIAL=m
CONFIG_MMC=y
CONFIG_RTC_CLASS=y
CONFIG_DMADEVICES=y
CONFIG_NBPFAXI_DMA=y
CONFIG_UIO=y
CONFIG_UIO_NETX=y
# CONFIG_ARM_ARCH_TIMER_EVTSTREAM is not set
# CONFIG_IOMMU_SUPPORT is not set
CONFIG_MEMORY=y
CONFIG_IIO=y
CONFIG_EXT4_FS=y
CONFIG_EXT4_FS_POSIX_ACL=y
CONFIG_FANOTIFY=y
CONFIG_AUTOFS4_FS=y
CONFIG_FUSE_FS=m
CONFIG_CUSE=m
CONFIG_OVERLAY_FS=m
CONFIG_MSDOS_FS=y
CONFIG_VFAT_FS=y
CONFIG_TMPFS=y
CONFIG_TMPFS_POSIX_ACL=y
CONFIG_NLS_CODEPAGE_437=m
CONFIG_NLS_ASCII=m
CONFIG_NLS_ISO8859_1=m
CONFIG_NLS_ISO8859_15=m
CONFIG_NLS_UTF8=m
CONFIG_CRYPTO_MD5=y
CONFIG_CRYPTO_SHA1=y
CONFIG_CRYPTO_DES=y
CONFIG_DEBUG_INFO=y
```
