/dts-v1/;
/plugin/;

/ {
	fragment@0 {
		target = <&adc1>;
		__overlay__ {
			status = "ok";
			vref = <3300>;
		};
	};
	__parameters__ {
		adc1.vref {
		      desc = "Reference voltage of ADC1 in mV";
		      node = "/fragment@0/__overlay__";
		      prop = "vref";
		      type = "unsigned";
		};
	};
};
